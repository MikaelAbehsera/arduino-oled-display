// Install:
// - Adafruit SSD1306
// - Adafruit GFX
// - Adafruit BusIO

// FOR BMP ONLY
// Use this website to convert images to bitmaps
// Make sure to use your respective canvas resolution!!! Mine was 128x64 for the 0.96 inch oled display
// - http://javl.github.io/image2cpp/

// Include Libs
#include <SPI.h>
#include <Wire.h>
#include <Adafruit_GFX.h>
#include <Adafruit_SSD1306.h>

// Canvas size
const int x = 128;
const int y = 64;
const int reset = -1;

// Create display
Adafruit_SSD1306 display(x, y, &Wire, reset);

void setup() {
  Serial.begin(115200);

  if (!display.begin(SSD1306_SWITCHCAPVCC, 0x3C)) {
    Serial.println(F("SSD1306 allocation failed"));
    for (;;)
      ;  // Don't proceed, loop forever
  }

  display.display();
  delay(2000);
  display.clearDisplay();

  // INSERT ANY DEMO FUNCTION HERE TO SEE IT ON THE DISPLAY (ON STARTUP/SETUP ONLY!)

  display.display();
  delay(2000);
}

void loop() {
}

// Creates a single pixel at x,y
void createPixel(int x, int y) {
  display.drawPixel(x, y, WHITE);
}

// Draws a line from top down -> left right
void animatedPixelDrawing() {
  for (int a = 0; a < 128; a++) {
    for (int b = 0; b < 64; b++) {
      display.drawPixel(a, b, WHITE);
      display.display();
      delay(2);
    }
  }
}

// Draws text at x,y
void drawText(string text, int x, int y) {
  display.setTextSize(1);       // Normal 1:1 pixel scale
  display.setTextColor(WHITE);  // Draw white text
  display.setCursor(x, y);      // Start at top-left corner
  display.println(F(text));
}

// Creates a rectangle inside a rectangle, until no more space.
void rectangleAnimation() {
  for (int16_t i = 0; i < display.height() / 2; i += 2) {
    display.drawRect(i, i, display.width() - 2 * i, display.height() - 2 * i, WHITE);
    display.display();
    delay(1);
  }
}

// EXAMPLE BITMAP OF RICK ASTLEY - NEVER GONNA GIVE YOU UP
const unsigned char picture[] PROGMEM = {
  0xff, 0xff, 0xff, 0xff, 0xff, 0xff, 0xff, 0xff, 0xff, 0xff, 0xff, 0xff, 0xff, 0xff, 0xff, 0xff,
  0xff, 0xff, 0xff, 0xff, 0xff, 0xff, 0xff, 0xff, 0xff, 0xff, 0xff, 0xff, 0xff, 0xff, 0xff, 0xff,
  0xff, 0xff, 0xff, 0xff, 0xff, 0xff, 0xff, 0xff, 0xff, 0xff, 0xff, 0xff, 0xff, 0xff, 0xff, 0xff,
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  0xff, 0xff, 0xff, 0xff, 0xf8, 0x00, 0x00, 0x00, 0x00, 0x00, 0x01, 0xff, 0xff, 0xff, 0xff, 0xff
};

// Display bitmap
void createPixel() {
  // Insert bitmap name here VVVVVVVV
  display.drawBitmap(0, 0, bitmapName, 128, 64, WHITE);
}
